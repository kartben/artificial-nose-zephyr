## drivers/sensor/Kconfig
```kconfig
# Copyright (c) 2021 Nordic Semiconductor ASA
# SPDX-License-Identifier: Apache-2.0

if SENSOR
rsource "multichannel_gas_v2/Kconfig"
endif # SENSOR
```

## drivers/sensor/multichannel_gas_v2/Kconfig
```kconfig
# Copyright (c) 2021 Nordic Semiconductor ASA
# SPDX-License-Identifier: Apache-2.0

config GROVE_MULTICHANNEL_GAS_SENSOR_V2
       bool "Seeed Grove Multichannel Gas Sensor V2"
       default y
       depends on DT_HAS_SEEED_GROVE_MULTICHANNEL_GAS_V2_ENABLED
       depends on I2C && !MINIMAL_LIBC
       help
         Enable driver for the Grove Multichannel Gas Sensor V2.
```

## dts/bindings/sensor/seeed,grove-multichannel_gas_v2.yaml
```yaml
compatible: "seeed,grove-multichannel-gas-v2"

include: [sensor-device.yaml, i2c-device.yaml]
```

## tests/lib/custom_lib/testcase.yaml
```yaml
common:
  tags: extensibility
  integration_platforms:
    - wio_terminal
tests:
  lib.custom_lib: {}
  lib.custom_lib.non_default:
    extra_args: CONFIG_CUSTOM_LIB_GET_VALUE_DEFAULT=6
```

## west.yml
```yaml
# Copyright (c) 2021 Nordic Semiconductor ASA
# SPDX-License-Identifier: Apache-2.0

manifest:
  self:
    west-commands: scripts/west-commands.yml

  remotes:
    - name: zephyrproject-rtos
      url-base: https://github.com/zephyrproject-rtos

  projects:
    - name: zephyr
      remote: zephyrproject-rtos
      revision: main
      import:
        # By using name-allowlist we can clone only the modules that are
        # strictly needed by the application.
        name-allowlist:
          - cmsis      # required by the ARM port
          - hal_espressif # ex. m5stack core 2
          - hal_atmel  # ex. wio terminal, ...
          - lvgl
          - mbedtls
```
