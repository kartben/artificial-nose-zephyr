&grove_i2c1 {
	status = "okay";

	gas_sensor: gas_sensor@8 {
		status = "okay";
		compatible = "seeed,grove-multichannel-gas-v2";
		reg = <0x08>;
	};
};

/ {
	i2c-dump-allowlist {
		compatible = "zephyr,i2c-dump-allowlist";
		devices = <&gas_sensor>;
	};
};

// /* overclock */
// &cpu0 {
// 	clock-frequency = <200000000>;
// };
